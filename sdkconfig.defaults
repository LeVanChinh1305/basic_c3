## sdkconfig.defaults
```kconfig
# ============================================================
# sdkconfig.defaults for ESP32-C3 BLE Mesh Basic project
# ============================================================

# --- Target ---
CONFIG_IDF_TARGET="esp32c3"

# --- Bluetooth Core ---
CONFIG_BT_ENABLED=y
CONFIG_BT_BLUEDROID_ENABLED=y
CONFIG_BT_CONTROLLER_ENABLED=y
CONFIG_BT_BLE_ENABLED=y
CONFIG_BT_GATTS_ENABLE=y
CONFIG_BT_BLUEDROID_ESP_COEX_VSC=y

# --- BLE 4.2 Features (required by BLE Mesh) ---
CONFIG_BT_BLE_42_FEATURES_SUPPORTED=y
CONFIG_BT_BLE_42_ADV_EN=y
CONFIG_BT_BLE_42_SCAN_EN=y
# CONFIG_BT_BLE_50_FEATURES_SUPPORTED is not set

# --- BLE Mesh ---
CONFIG_BLE_MESH=y
CONFIG_BLE_MESH_NODE=y
CONFIG_BLE_MESH_PROV=y
CONFIG_BLE_MESH_PB_ADV=y
CONFIG_BLE_MESH_PB_GATT=y
CONFIG_BLE_MESH_PROXY=y
CONFIG_BLE_MESH_GATT_PROXY_SERVER=y
CONFIG_BLE_MESH_RELAY=y
CONFIG_BLE_MESH_SETTINGS=y
CONFIG_BLE_MESH_USE_DUPLICATE_SCAN=y
CONFIG_BLE_MESH_HCI_5_0=y
CONFIG_BLE_MESH_HEALTH_SRV=y
CONFIG_BLE_MESH_GENERIC_SERVER=y
CONFIG_BLE_MESH_TRACE_LEVEL_WARNING=y
CONFIG_BLE_MESH_NET_BUF_TRACE_LEVEL_WARNING=y
CONFIG_BLE_MESH_DEINIT=y
CONFIG_BLE_MESH_ADV_BUF_COUNT=60
CONFIG_BLE_MESH_SUBNET_COUNT=3
CONFIG_BLE_MESH_APP_KEY_COUNT=3
CONFIG_BLE_MESH_MODEL_KEY_COUNT=3
CONFIG_BLE_MESH_MODEL_GROUP_COUNT=3
CONFIG_BLE_MESH_CRPL=10
CONFIG_BLE_MESH_MSG_CACHE_SIZE=10
CONFIG_BLE_MESH_STORE_TIMEOUT=0
CONFIG_BLE_MESH_SEQ_STORE_RATE=0
CONFIG_BLE_MESH_RPL_STORE_TIMEOUT=0
CONFIG_BLE_MESH_DISCARD_OLD_SEQ_AUTH=y
CONFIG_BLE_MESH_V11_SUPPORT=y
CONFIG_BLE_MESH_MEM_ALLOC_MODE_INTERNAL=y
CONFIG_BLE_MESH_UNPROVISIONED_BEACON_INTERVAL=5
CONFIG_BLE_MESH_NODE_ID_TIMEOUT=60
CONFIG_BLE_MESH_PROXY_FILTER_SIZE=4
CONFIG_BLE_MESH_NET_BUF_POOL_USAGE=y
CONFIG_BLE_MESH_TX_SEG_MSG_COUNT=1
CONFIG_BLE_MESH_RX_SEG_MSG_COUNT=1
CONFIG_BLE_MESH_RX_SDU_MAX=384
CONFIG_BLE_MESH_TX_SEG_MAX=32

# --- Partition Table ---
CONFIG_PARTITION_TABLE_CUSTOM=y
CONFIG_PARTITION_TABLE_CUSTOM_FILENAME="partitions_custom.csv"

# --- Flash Size 4MB ---
CONFIG_ESPTOOLPY_FLASHSIZE_4MB=y
CONFIG_ESPTOOLPY_FLASHSIZE="4MB"

# --- Console: Dung UART (COM4, 115200) ---
# C3 co the dung UART thong qua chip USB-UART (CH340/CP2102)
CONFIG_ESP_CONSOLE_UART_DEFAULT=y
```
